## conf/layer.conf
```bitbake
# We have a conf and classes directory, add to BBPATH
BBPATH .= ":${LAYERDIR}"

# We have a recipes-* directories, add to BBFILES
BBFILES += "${LAYERDIR}/recipes-*/*/*.bb \
	${LAYERDIR}/recipes-*/*/*.bbappend"

BBFILE_COLLECTIONS += "rockpro64-hacks-layer"
BBFILE_PATTERN_rockpro64-hacks-layer = "^${LAYERDIR}/"
BBFILE_PRIORITY_rockpro64-hacks-layer = "6"

LAYERDEPENDS_rockpro64-hacks-layer_append = " rockchip rockchip_extra"
#LAYERDEPENDS_rockpro64-hacks-layer_append = " readonly-rootfs-overlay"
```

## conf/machine/rockpro64.conf
```bitbake
# from meta-rockchip
require conf/machine/include/rk3399.inc

# Kernel:
# ayufan
#PREFERRED_PROVIDER_virtual/kernel = "linux-yocto-custom"
# rockchip
PREFERRED_PROVIDER_virtual/kernel = "linux-rockchip"
PREFERRED_VERSION_linux-rockchip = "4.4.%"

# U-Boot:
# ayufan
#PREFERRED_PROVIDER_virtual/bootloader = "u-boot-ayufan"
#UBOOT_MACHINE = "rockpro64-rk3399_defconfig"
# rockchip
PREFERRED_PROVIDER_virtual/bootloader ?= "u-boot"
UBOOT_MACHINE = "evb-rk3399_defconfig"

# Device Tree:
# ayufan
#KERNEL_DEVICETREE = "rk3399-rockpro64.dtb"
# rockchip
KERNEL_DEVICETREE = "rockchip/rk3399-rockpro64.dtb"

# Kernel Command Line:

# NOT USED
# modify the behavior of uboot-extlinux-config.bbclass
# to change the kernel command line
#UBOOT_EXTLINUX = "1"
#UBOOT_EXTLINUX_ROOT = "root=PARTUUID=${uuid}"
#UBOOT_EXTLINUX_CONSOLE = "console=tty99"
#UBOOT_EXTLINUX_CONSOLE = ""

# NOTE - This controls the kernel command line args by way of rockchip-gpt-img.bbclass
#GPTIMG_APPEND_rk3399 = "console=tty1 console=ttyFIQ0,1500000n8 rw \
#        root=PARTUUID=b921b045-1d rootfstype=ext4 init=/sbin/init rootwait"
GPTIMG_APPEND_rockpro64 = "console=ttyS2,1500000n8 rw root=PARTUUID=b921b045-1d rootfstype=ext4 init=/sbin/init rootwait"
```
